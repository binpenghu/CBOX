/****************************************************************************
// Copyright (c) 2017
//
// @Module        
// @Filename      
// @Project       
// @Author        HBP
//----------------------------------------------------------------------------
// @Controller    STM8S
//
// @Compiler      IAR
//
// @Description   
//
//----------------------------------------------------------------------------
// @Date          2017
// @Version       V1.0
****************************************************************************/

//****************************************************************************
// @Project Includes
//****************************************************************************
#include "Logic.h"
//****************************************************************************
// @Macros
//****************************************************************************

//****************************************************************************
// @Defines
//****************************************************************************

//****************************************************************************
// @Typedefs
//****************************************************************************
typedef enum
{
	BAT_6V=0,
	BAT_12V,
	BAT_24V,
	BAT_36V,
	BAT_48V,
	BAT_MAX
}BAT_VOL_T;

typedef struct
{
	u16 batLowVolt;
	u16 batHighVolt;
	u16 batNorVolt;
	u16 batOffset;
	u16 batAiErrVolt;  //=batHighVolt+0.1v*(6V基数)。
}BAT_VOLTAGE_T;


typedef enum
{
	BAT_IS_NON,
	BAT_IS_NORMAL,
	BAT_IS_REVERSE,
	BAT_IS_ERROR
}BAT_STA_T;

typedef struct
{
	u8 batVoltSta;
	u8 inVoltSta;
}CHARGE_DATA_T;
//****************************************************************************
// @Imported Global Variables
//****************************************************************************
const BAT_VOLTAGE_T batTable[BAT_MAX]= // unit is 0.1v
{
	{48,72,55,5,73},		//6v
	{96,143,114,5,145},		//12v
	{192,286,228,5,290},	//24v
	{288,432,331,5,438},	//36v
	{440,576,441,5,584},	//48v
};

static u8 batteryType = 0;
//****************************************************************************
// @Global Variables
//****************************************************************************
CHARGE_DATA_T chargeSta;

//****************************************************************************
// @Prototypes Of Static Functions
//****************************************************************************

//****************************************************************************
// @Prototypes Of Global Functions
//****************************************************************************

/******************************************************************************
 *  Function:
 *  Parameters: None
 *  Returns: None
 *  Description:   
 ******************************************************************************/

/******************************************************************************
 *	Function:
 *	Parameters: None
 *	Returns: 
 *	Description:   电瓶电压是否在范围内。 
 ******************************************************************************/
u8 judgeBatType(u16 batval,CHARGE_DATA_T*chargeSta)
{
	//u16 batVal = 0;
	u8 i=0;
	batteryType = 0xff;
	if (BAT_REVERSE == getBatConnectSta())
	{
		return BAT_IS_REVERSE;
	}
	
	if (batval == 0)
	{
		return BAT_IS_NON;
	}else
	{
		for (i=0;i<BAT_MAX;i++)
		{
			if (batval <= batTable[i].batHighVolt && batval >= batTable[i].batLowVolt)
			{
				batteryType = i;
				return BAT_IS_NORMAL;	
			}
		}
	}
	return BAT_IS_ERROR;
}
/******************************************************************************
 *  Function:
 *  Parameters: None
 *  Returns: None
 *  Description:   判断是否进入充电模式
 ******************************************************************************/
u8 judgeChargeMode(u16 inval,u16 batval)
{
	if (batteryType == 0xff)
		return 0;
	if (D24V_VALID ==  getD24Sta())
	{
		if(inval <= batTable[batteryType].batNorVolt && 
			inval >= batTable[batteryType].batLowVolt)
		{
			
		}
			
	}
	
}

//****************************************************************************
// @Interrupt Vectors
//****************************************************************************

/*
 *######################################################################
 *                           End of File
 *######################################################################
 */






