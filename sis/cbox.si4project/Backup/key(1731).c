
/****************************************************************************
// Copyright (c) 2017
//
// @Module        
// @Filename      
// @Project       
// @Author        HBP
//----------------------------------------------------------------------------
// @Controller    STM8S
//
// @Compiler      IAR
//
// @Description   
//
//----------------------------------------------------------------------------
// @Date          2017
// @Version       V1.0
****************************************************************************/

//****************************************************************************
// @Project Includes
//****************************************************************************
#include "key.h"
#include "bsp.h"
#include "delay.h"
//****************************************************************************
// @Macros
//****************************************************************************

//****************************************************************************
// @Defines
//****************************************************************************

//****************************************************************************
// @Typedefs
//****************************************************************************





enum
{
	KEY_VALID=0,
	KEY_INVALID=1
};
//****************************************************************************
// @Imported Global Variables
//****************************************************************************

//****************************************************************************
// @Global Variables
//****************************************************************************
extern u8 keyValTest;
//****************************************************************************
// @Prototypes Of Static Functions
//****************************************************************************

//****************************************************************************
// @Prototypes Of Global Functions
//****************************************************************************

/******************************************************************************
 *  Function:
 *  Parameters: None
 *  Returns: None
 		
 *  Description:   detest press valid.
 ******************************************************************************/
u8 getKeyStatus(void)
{
	static u8 longPressFlag=0;
	if(KEY_PRESS == getKeySwSta() && longPressFlag==0)
	{
		delay_ms(4);
		if (KEY_PRESS == getKeySwSta())
		{
			longPressFlag=1;
			return KEY_VALID;
		}
	}else if (KEY_RELEASE == getKeySwSta() )
	{
		longPressFlag=0;
	}
	return KEY_INVALID;
}

/******************************************************************************
 *  Function:
 *  Parameters: None
 *  Returns: None
 *  Description:   
 ******************************************************************************/
KEY_VALUE_E key_task(void)
{
	static KEY_VALUE_E keyVal = V_KEY;
	if (KEY_VALID == getKeyStatus())
	{
		//keyVal = keyVal<MAX_KEY?keyVal++:V_KEY;
        if (++keyVal >= MAX_KEY)
        {
           keyVal = V_KEY;
        }
	}
	return keyVal;
}
/******************************************************************************
 *  Function:
 *  Parameters: None
 *  Returns: None
 *  Description:   
 ******************************************************************************/

//****************************************************************************
// @Interrupt Vectors
//****************************************************************************

/*
 *######################################################################
 *                           End of File
 *######################################################################
 */






