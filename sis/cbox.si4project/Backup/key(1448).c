
/****************************************************************************
// Copyright (c) 2017
//
// @Module        
// @Filename      
// @Project       
// @Author        HBP
//----------------------------------------------------------------------------
// @Controller    STM8S
//
// @Compiler      IAR
//
// @Description   
//
//----------------------------------------------------------------------------
// @Date          2017
// @Version       V1.0
****************************************************************************/

//****************************************************************************
// @Project Includes
//****************************************************************************
#include "bsp.h"
#include "delay.h"
//****************************************************************************
// @Macros
//****************************************************************************

//****************************************************************************
// @Defines
//****************************************************************************

//****************************************************************************
// @Typedefs
//****************************************************************************
typedef enum
{
	V_KEY = 1,
	A_KEY = 2,
	AH_KEY = 3,
	PER_KEY = 4,
	MAX_KEY =5
}KEY_VALUE_E;

KEY_VALUE_E keyVal;



//****************************************************************************
// @Imported Global Variables
//****************************************************************************

//****************************************************************************
// @Global Variables
//****************************************************************************
extern u8 keyValTest;
//****************************************************************************
// @Prototypes Of Static Functions
//****************************************************************************

//****************************************************************************
// @Prototypes Of Global Functions
//****************************************************************************

/******************************************************************************
 *  Function:
 *  Parameters: None
 *  Returns: None
 *  Description:   
 ******************************************************************************/
u8 getKeyStatus(void)
{
	static u8 longPressFlag=0;
	if(KEY_PRESS == getKeySwSta() && longPressFlag==0)
	{
		delay_ms(4);
		if (KEY_PRESS == getKeySwSta())
		{
			longPressFlag=1;
			return 1;
		}
	}else if (KEY_RELEASE == getKeySwSta())
	{
		longPressFlag=0;
	}
	return 0;
}

/******************************************************************************
 *  Function:
 *  Parameters: None
 *  Returns: None
 *  Description:   
 ******************************************************************************/
void key_task(void)
{
	if ( 0!=getKeyStatus())
	{
		keyVal = keyVal<MAX_KEY?keyVal++:V_KEY;	
		keyValTest++;
		//call display
	}
}
/******************************************************************************
 *  Function:
 *  Parameters: None
 *  Returns: None
 *  Description:   
 ******************************************************************************/

//****************************************************************************
// @Interrupt Vectors
//****************************************************************************

/*
 *######################################################################
 *                           End of File
 *######################################################################
 */






